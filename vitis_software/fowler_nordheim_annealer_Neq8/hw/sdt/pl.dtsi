/ {
	amba_pl: amba_pl {
		ranges;
		compatible = "simple-bus";
		#address-cells = <1>;
		#size-cells = <1>;
		firmware-name = "whole_system_wrapper.bit.bin";
		clocking0: clocking0 {
			compatible = "xlnx,fclk";
			assigned-clocks = <&clkc 15>;
			assigned-clock-rates = <50000000>;
			#clock-cells = <0>;
			clock-output-names = "fabric_clk";
			clocks = <&clkc 15>;
		};
		fowler_nordheim_anne_0: fowler_nordheim_annealer@40000000 {
			xlnx,temp-inc-width = <12>;
			xlnx,solution-width = <16>;
			compatible = "xlnx,fowler-nordheim-annealer-1.0";
			xlnx,pipelined-ensemble-storage = <1>;
			xlnx,use-transmit-with-buff = <1>;
			xlnx,unit-width = <1>;
			xlnx,counter-width = <40>;
			xlnx,temperature-lut-filename = "temperature_LUT_fixed_N9.mif";
			xlnx,rable = <0>;
			xlnx,s00-axi-data-width = <32>;
			xlnx,use-float-point = <0>;
			xlnx,idx-that-fired-width = <3>;
			xlnx,ip-name = "fowler_nordheim_annealer";
			xlnx,graph-width = <8>;
			xlnx,pipelined-roms = <1>;
			reg = <0x40000000 0x1000>;
			clocks = <&clkc 15>;
			xlnx,neuron-sel-lfsr-width = <5>;
			xlnx,neuron-num-width = <2>;
			xlnx,no-of-clk-cycles-to-update-membrane = <3>;
			xlnx,units = <2>;
			xlnx,no-clk-cycles-after-update = <4>;
			xlnx,neurons-per-unit = <4>;
			xlnx,membrane-width = <10>;
			xlnx,edk-iptype = "PERIPHERAL";
			xlnx,flipping-output-width = <16>;
			xlnx,temperature-lut-width = <9>;
			xlnx,no-of-clk-cycles-to-propagate = <1>;
			status = "okay";
			clock-names = "s00_axi_aclk";
			xlnx,s00-axi-addr-width = <5>;
			xlnx,fractional-part = <9>;
			xlnx,log-noise-source-width = <16>;
			xlnx,log-lut-bit-size = <8>;
			xlnx,use-round-robin = <0>;
			xlnx,real-width = <18>;
			xlnx,name = "fowler_nordheim_anne_0";
		};
	};
};
